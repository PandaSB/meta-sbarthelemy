## conf/layer.conf
```bitbake
# We have a conf and classes directory, append to BBPATH
BBPATH .= ":${LAYERDIR}"

# We have a recipes directory containing .bb and .bbappend files, add to BBFILES
BBFILES += "${LAYERDIR}/recipes*/*/*.bb \
            ${LAYERDIR}/recipes*/*/*.bbappend"

BBFILE_COLLECTIONS += "sbarthelemy"
BBFILE_PATTERN_sbarthelemy := "^${LAYERDIR}/"
BBFILE_PRIORITY_sbarthelemy = "15"

# Additional license directories.
LICENSE_PATH += "${LAYERDIR}/files/custom-licenses"
```
